/********************************Copyright (c)**********************************
**
**                   (c) Copyright 2019, Main, China, QD.
**                           All Rights Reserved
**
**                      		 XXXXXXXXX有限公司
**                           
**
**----------------------------------文件信息------------------------------------
** 文件名称: drv_i2c.c
** 创建人员: Andy
** 创建日期: 2021/4/03 15:40
** 文档描述: AD采集模块-PCF8591T的.c文件
**			 8-Bit COMS, 1路模拟输出 + 4路模拟输入
**           IIC通信，VCC: 3.3~5V
**----------------------------------版本信息------------------------------------
** 版本代号: V0.0.0.1
** 版本说明: 初始版本
**
**------------------------------------------------------------------------------
*/

#include "drv_i2c.h"
#include "drv_ad_pcf8591.h"

/*******************************************************************************
** 功能描述: DAC 变换转化
** 参数说明: address：地址/指令(8Bit)
**           cmd: 控制指令(8Bit)
**           val: 发送DAC的数值
** 返回说明: IIC_ACK_OK:发送成功   IIC_ACK_ERR:发送失败
** 创建人员: Andy
** 创建日期: 2021/4/03 14:45
**------------------------------------------------------------------------------
** 修改人员: wxd
** 修改日期: 2021/4/04
** 修改描述: 新作
**------------------------------------------------------------------------------
********************************************************************************/
uint8_t drv_pcf8591_send_value(uint8_t address, uint8_t cmd, uint8_t val)
{
	uint8_t ret;
	
	/* 启动总线 */
	drv_i2c_start(); 
	
	/* 发送器件地址 */
	ret = drv_i2c_send_byte(address); 
	if(ret)
	{
		return IIC_ACK_ERR;
	}
	
	/* 发送控制字节 */	
	ret = drv_i2c_send_byte(cmd); 
	if(ret)
	{
		return IIC_ACK_ERR;
	}
	
	/* 发送DAC的数值 */
	ret = drv_i2c_send_byte(val); 
	if(ret)
	{
		return IIC_ACK_ERR;
	}
	
	/* 结束总线 */
	drv_i2c_stop();

	return IIC_ACK_OK;
}

/*******************************************************************************
** 功能描述: 向指定地址发送数据
** 参数说明: address：地址/指令(8Bit)
**           dat: 数据(8Bit)
** 返回说明: IIC_ACK_OK:发送成功   IIC_ACK_ERR:发送失败
** 创建人员: Andy
** 创建日期: 2021/4/03 14:45
**------------------------------------------------------------------------------
** 修改人员: wxd
** 修改日期: 2021/4/04
** 修改描述: 新作
**------------------------------------------------------------------------------
********************************************************************************/
uint8_t drv_pcf8591_send_byte(uint8_t address, uint8_t dat)
{
	uint8_t ret;
	
	/* 启动总线 */
	drv_i2c_start(); 
	
	/* 发送器件地址 */
	ret = drv_i2c_send_byte(address); 
	if(ret)
	{
		return IIC_ACK_ERR;
	}

	/* 发送数据 */	
	ret = drv_i2c_send_byte(dat); 
	if(ret)
	{
		return IIC_ACK_ERR;
	}
	
	/* 结束总线 */
	drv_i2c_stop();

	return IIC_ACK_OK;
}

/*******************************************************************************
** 功能描述: ADC读字节数据函数
** 参数说明: 无 
** 返回说明: retc: 数据(8Bit)
** 创建人员: Andy
** 创建日期: 2021/4/03 14:45
**------------------------------------------------------------------------------
** 修改人员: wxd
** 修改日期: 2021/4/04
** 修改描述: 新作
**------------------------------------------------------------------------------
********************************************************************************/
uint8_t drv_pcf8591_read_byte(uint8_t sla)
{  
	uint8_t rec, ret;

	/* 启动总线 */
	drv_i2c_start();
	
	/* 发送器件地址 */
	ret = drv_i2c_send_byte(sla + 1); 
	if(ret)
	{
		return IIC_ACK_ERR;
	}
   
	/* 读取数据 */
	rec = drv_i2c_rev_byte();          
	
	/* 发送非就答位 */
	drv_i2c_ack(IIC_ACK_OK);  

	/* 结束总线 */
	drv_i2c_stop();
	
	return rec;
}

/*------------------------------------By_Andy_2021/4/03 15:35------------------------------*/
/*-----------------------------------------------------------------------------------------*/
